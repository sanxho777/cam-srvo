## sdkconfig.defaults
```kconfig
# Target
CONFIG_IDF_TARGET="esp32s3"
CONFIG_IDF_TARGET_ESP32S3=y

# Flash — 16MB (Goouuu ESP32-S3-CAM is N16R8: 16MB Flash, 8MB PSRAM)
CONFIG_ESPTOOLPY_FLASHSIZE_16MB=y
CONFIG_PARTITION_TABLE_CUSTOM=y
CONFIG_PARTITION_TABLE_CUSTOM_FILENAME="partitions.csv"

# OV3660 camera sensor support
CONFIG_OV3660_SUPPORT=y

# PSRAM — 8MB OPI (Octal SPI) PSRAM on N16R8
CONFIG_SPIRAM=y
CONFIG_SPIRAM_MODE_OCT=y
CONFIG_SPIRAM_SPEED_80M=y
CONFIG_SPIRAM_USE_MALLOC=y
CONFIG_SPIRAM_MALLOC_ALWAYSINTERNAL=16384

# CPU — 240 MHz for better camera DMA throughput
CONFIG_ESP_DEFAULT_CPU_FREQ_MHZ_240=y

# Main task stack
CONFIG_ESP_MAIN_TASK_STACK_SIZE=8192
CONFIG_PTHREAD_TASK_STACK_SIZE_DEFAULT=4096

# FreeRTOS — 1000 Hz for smoother task scheduling
CONFIG_FREERTOS_HZ=1000

# HTTP server
CONFIG_HTTPD_MAX_REQ_HDR_LEN=1024
CONFIG_HTTPD_MAX_URI_LEN=512
CONFIG_HTTPD_WS_SUPPORT=y

# WiFi TX/RX tuning for sustained MJPEG stream
CONFIG_ESP_WIFI_STATIC_RX_BUFFER_NUM=16
CONFIG_ESP_WIFI_DYNAMIC_RX_BUFFER_NUM=32
CONFIG_ESP_WIFI_DYNAMIC_TX_BUFFER_NUM=32

# TCP tuning — larger window = higher throughput on LAN
CONFIG_LWIP_TCP_SND_BUF_DEFAULT=65535
CONFIG_LWIP_TCP_WND_DEFAULT=65535
CONFIG_LWIP_TCP_RECVMBOX_SIZE=16

# Log level
CONFIG_LOG_DEFAULT_LEVEL_INFO=y
```
